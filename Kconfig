## Kconfig
```kconfig
config DUST_CMD_SHELL
    bool "Self-maintained UART debug console (thread + command dispatch)"
    default n
    select DUST_COM_UART_DMA
    help
        Common shell thread: UART receive loop + command dispatch.
        var/log sub-commands are gated by their own symbols.

config DUST_CMD_SHELL_VAR
    bool "var sub-commands (var list/get/set)"
    default n
    select DUST_CMD_SHELL
    help
        Debug variable interaction: var list (list), var get <name>,
        var set <name> <v>. Threads register variables via REGISTER_SHELL_VAR().

config DUST_CMD_SHELL_LOG
    bool "DUST_LOG system + log sub-commands (log list/on/off)"
    default n
    select DUST_CMD_SHELL
    help
        Self-made DMA log system: INF/ERR/OK/WRN direct print (4 colors),
        DBG selectable streaming via log on/off. Requires the shell thread.
```
